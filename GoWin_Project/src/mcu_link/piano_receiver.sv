// Validates and atomically commits the 34-byte AA 56 piano snapshot.
module piano_receiver #(
    parameter integer CLK_HZ=50000000,
    parameter integer TIMEOUT_MS=75
)(
    input wire clk, rst_n,
    input wire [271:0] frame,
    input wire frame_valid,
    output reg [7:0] base_note,
    output reg [15:0] seq,
    output reg [47:0] pressed,
    output reg [143:0] force_values,
    output reg snapshot_valid,
    output reg link_alive,
    output reg timeout_event,
    output reg [31:0] good_count,
    output reg [31:0] field_error_count,
    output reg [31:0] duplicate_sequence_count,
    output reg [31:0] discontinuity_count,
    output reg [31:0] timeout_count
);
    localparam integer TIMEOUT_CLKS=(CLK_HZ/1000)*TIMEOUT_MS;
    localparam integer AGE_W=(TIMEOUT_CLKS < 2) ? 1 : $clog2(TIMEOUT_CLKS+1);
    reg [AGE_W-1:0] age;
    reg have_sequence;
    reg fields_ok;
    integer i;
    integer n;

    always @* begin
        fields_ok = 1'b0;
        if (frame[23:16] == 8'h02) begin
            // v2: fixed C3..B6, 48-bit mask, reserved payload must be zero.
            fields_ok = frame[31:24] == 8'd48 && frame[255:96] == 160'd0;
        end else begin
        fields_ok = (frame[23:16] == 8'h01) && (frame[31:24] <= 8'd116) &&
                    (frame[63:60] == 4'd0);
        for (i=0; i<12; i=i+1) begin
            if (frame[64+i*16+15 -: 4] != 4'd0)
                fields_ok = 1'b0;
            if (!frame[48+i] && frame[64+i*16 +: 16] != 16'd0)
                fields_ok = 1'b0;
            // A pressed key with zero force is not generated by the MCU.
            if (frame[48+i] && frame[64+i*16 +: 16] == 16'd0)
                fields_ok = 1'b0;
        end
        end
    end

    always @(posedge clk or negedge rst_n) begin
        if (!rst_n) begin
            base_note<=0; seq<=0; pressed<=0; force_values<=0;
            snapshot_valid<=0; link_alive<=0; timeout_event<=0; age<=0;
            have_sequence<=0; good_count<=0; field_error_count<=0;
            duplicate_sequence_count<=0; discontinuity_count<=0; timeout_count<=0;
        end else begin
            snapshot_valid<=0;
            timeout_event<=0;
            if (link_alive) begin
                if (age == TIMEOUT_CLKS-1) begin
                    link_alive<=0;
                    timeout_event<=1;
                    timeout_count<=timeout_count+1'b1;
                end else age<=age+1'b1;
            end
            if (frame_valid) begin
                if (!fields_ok) begin
                    field_error_count<=field_error_count+1'b1;
                end else begin
                    base_note<=frame[31:24];
                    seq<=frame[47:32];
                    pressed <= frame[23:16] == 8'h02 ? frame[95:48] : {36'd0, frame[59:48]};
                    for (n=0; n<12; n=n+1)
                        force_values[n*12 +: 12] <= frame[23:16] == 8'h02 ? 12'd0 : frame[64+n*16 +: 12];
                    snapshot_valid<=1;
                    good_count<=good_count+1'b1;
                    link_alive<=1;
                    age<=0;
                    timeout_event<=0;
                    if (have_sequence) begin
                        if (frame[47:32] == seq)
                            duplicate_sequence_count<=duplicate_sequence_count+1'b1;
                        else if (frame[47:32] != seq + 16'd1)
                            discontinuity_count<=discontinuity_count+1'b1;
                    end
                    have_sequence<=1;
                end
            end
        end
    end
endmodule
